/*
 * EnvironmentSensorTests.ino
 * 
 * A simple comparision of several different enviroment sensors.
 * The DHT11 sensor uses the Timer class available in mbed OS
 * to get a timer with a greater precision than the default on 
 * the Nano 33 BLE Sense.
 * 
 */
#include <Wire.h>
#include <Arduino_HTS221.h>
#include <Arduino_LPS22HB.h>
#include <Adafruit_Sensor.h>
#define NO_ADAFRUIT_SSD1306_COLOR_COMPATIBILITY
#include <Adafruit_GFX.h>
#include <Adafruit_SSD1306.h>


// the OLED display
Adafruit_SSD1306 display(128, 32);
#define SCREEN_WIDTH 128
#define SCREEN_HEIGHT 32

//Adafruit_SSD1306 display(SCREEN_WIDTH, SCREEN_HEIGHT, &Wire, -1);

// 'logo_Analytics_Logo(1)', 128x32px
const unsigned char myBitmap [] PROGMEM = {
  0x00, 0x00, 0x00, 0x00, 0x00, 0x00, 0x00, 0x00, 0x00, 0x00, 0x00, 0x00, 0x00, 0x00, 0x00, 0x00, 
  0x00, 0x00, 0x00, 0x00, 0x00, 0x00, 0x00, 0x00, 0x00, 0x00, 0x00, 0x00, 0x00, 0x00, 0x00, 0x00, 
  0x00, 0x00, 0x00, 0x30, 0x00, 0x00, 0x00, 0x00, 0x00, 0x00, 0x00, 0x00, 0x00, 0x00, 0x00, 0x00, 
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  0x00, 0x00, 0x00, 0x00, 0x00, 0x00, 0x00, 0x00, 0x00, 0x00, 0x00, 0x00, 0x00, 0x00, 0x00, 0x00
};

void setup() {
  Serial.begin(9600);  
 
  if(!display.begin(SSD1306_SWITCHCAPVCC, 0x3C)) {
    Serial.println(F("SSD1306 allocation failed"));
    for(;;);
  }
  delay(2000); // Pause for 2 seconds
 
  // Clear the buffer.
  display.clearDisplay();
  
  // Draw bitmap on the screen
  display.drawBitmap(0, 0, myBitmap, 128, 32, 1);
  display.display();
  delay(4000);




  // put your setup code here, to run once:

  
  
  
  if (!HTS.begin()) {
    Serial.println("Error initializing HTS sensor\n");
    while (1);
  }
  if (!BARO.begin()) {
    Serial.println("Failed to initialize pressure sensor!");
    while (1);
  }

  if (!display.begin(SSD1306_SWITCHCAPVCC, 0x3C)) {
    Serial.println("Error initializing OLED display\n");
    while (1);
  }

  Serial.print("Clock = "); 
  Serial.println(SystemCoreClock);
}

void loop() {
  float hts_temp, hts_humidity;
  
  hts_temp = HTS.readTemperature();
  hts_humidity = HTS.readHumidity();
  float pressure = BARO.readPressure(PSI);

  
  // HTS221 - on board on the Nano 33 BLE Sense
//  Serial.print("HTS temp = ");
//  Serial.print(hts_temp);
//  Serial.print(", humidity = ");
//  Serial.println(hts_humidity);

  display.clearDisplay();
  display.setTextColor(SSD1306_WHITE);
  display.setCursor(0, 0); 
  display.print("Temp = ");
  display.print(hts_temp);
  display.print("°C");
  display.setCursor(0, 8);
  display.print("humidity = ");
  display.print(hts_humidity);
  display.print("%");
  display.setCursor(0, 24);
  display.print("Pressure = ");
  display.print(pressure);
  display.print("PSI");
  display.setCursor(0, 32);
  display.print("Pressure = ");
  display.print(pressure);
  display.print("PSI");
  display.display();
  
  delay(1000);
}
